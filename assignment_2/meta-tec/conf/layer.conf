## assignment_2/meta-tec/conf/layer.conf
```bitbake
# We have a conf and classes directory, add to BBPATH
BBPATH .= ":${LAYERDIR}"

# We have recipes-* directories, add to BBFILES
BBFILES += "${LAYERDIR}/recipes-*/*.bb \
            ${LAYERDIR}/images/*.bb \"

BBFILE_COLLECTIONS += "meta-tec"
BBFILE_PATTERN_meta-tec = "^${LAYERDIR}/"
BBFILE_PRIORITY_meta-tec = "6"

LAYERDEPENDS_meta-tec = "core"
LAYERSERIES_COMPAT_meta-tec = "warrior"

# Add to tec-image the following recipes
IMAGE_INSTALL += "rgb2yuv-c rgb2yuv-intrinsics c-doc intrinsics-doc"
```
